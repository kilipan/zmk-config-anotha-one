## config/west.yml
```yaml
manifest:
  remotes:
    - name: zmkfirmware
      url-base: https://github.com/zmkfirmware
    - name: LukaOber
      url-base: https://github.com/LukaOber
  projects:
    - name: zmk
      remote: zmkfirmware
      revision: main
      import: app/west.yml
    - name: zmk-anotha-one
      remote: LukaOber
      revision: master
  self:
    path: config
```
